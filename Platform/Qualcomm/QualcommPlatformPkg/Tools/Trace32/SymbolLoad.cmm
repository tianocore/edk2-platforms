;;@file
;;  Loads UEFI symbols from DDR buffer.
;;
;;  Copyright (c) Qualcomm Technologies, Inc. and/or its subsidiaries.<BR>
;;  SPDX-License-Identifier: BSD-2-Clause-Patent
;;

;============================================================================
;  FUNCTION:  main
;
;  ARGUMENTS:
;    &DebugScriptMetaDataBufferAddress - Base address of the debug script metadata buffer.
;    &DebugScriptMetaDataBufferSize    - Size of the debug script metadata buffer.
;============================================================================
ENTRY &DebugScriptMetaDataBufferAddress &DebugScriptMetaDataBufferSize

LOCAL &CwDir
LOCAL &WorkspaceRoot
LOCAL &TempFile
LOCAL &TempDir
LOCAL &HeaderMagic
LOCAL &ScriptLen
LOCAL &ScriptStart
LOCAL &ScriptEnd
LOCAL &WrapperFile
LOCAL &CurrAddr
LOCAL &MatchState
LOCAL &NameStart
LOCAL &NameLen
LOCAL &PkgName
LOCAL &ByteVal

&CwDir=os.ppd()
&TempDir=os.ptd()

; Debug protocol layout offset
LOCAL &HeaderOffset
&HeaderOffset=0x48

IF "&DebugScriptMetaDataBufferAddress"==""
(
  DIALOG.OK "Debug script metadata buffer address argument is required."
  ENDDO
)

&WorkspaceRoot="&CwDir/../../../../../.."

&TempFile="&TempDir/SymbolLoadExtracted.cmm"
&WrapperFile="&TempDir/SymbolLoadWrapper.cmm"

;----------------------------------------------------------------------------
; 1. Setup T32 Environment
;----------------------------------------------------------------------------
AREA.CLEAR
AREA.RESET
AREA.CREATE UEFI_Logs 1000. 8192.
AREA.SELECT UEFI_Logs
AREA.view UEFI_Logs

PRINT "Checking for UEFI Symbol Script at &DebugScriptMetaDataBufferAddress..."

;----------------------------------------------------------------------------
; 2. Check Header
;----------------------------------------------------------------------------
; Read Magic (0x314D4D43 = 'CMM1') using ezaxi: access class
; Header is at offset HeaderOffset
&HeaderMagic=Data.Long(ezaxi:&DebugScriptMetaDataBufferAddress+&HeaderOffset)

IF (&HeaderMagic!=0x314D4D43)
(
  DIALOG.OK "Error: No valid CMM header found at &DebugScriptMetaDataBufferAddress+&HeaderOffset"
  ENDDO
)

; Read WriteOffset (length of script) at offset 8 from header
&ScriptLen=Data.Long(ezaxi:&DebugScriptMetaDataBufferAddress+&HeaderOffset+0x8)

IF (&ScriptLen==0)
(
  DIALOG.OK "Script length is 0. No symbols loaded yet."
  ENDDO
)

; Script starts at base + 0x58 (immediately after the 16-byte header at 0x48)
&ScriptStart=&DebugScriptMetaDataBufferAddress+0x58
&ScriptEnd=&ScriptStart+&ScriptLen-1

;----------------------------------------------------------------------------
; 3. Generate Wrapper with Path Mapping
;----------------------------------------------------------------------------
; We parse the script directly from DDR to find "global &Pkg" declarations.
; This avoids macro expansion issues that happen when reading text lines into macros.

OPEN #2 "&WrapperFile" /Create

; Write standard header
WRITE #2 "; Wrapper script generated by SymbolLoad.cmm"

PRINT "Scanning script for packages..."

&CurrAddr=&ScriptStart
&MatchState=0
; States:
; 0: Waiting for 'g'
; 1: 'l'
; 2: 'o'
; 3: 'b'
; 4: 'a'
; 5: 'l'
; 6: ' ' (space)
; 7: '&'
; 8: Reading Name

WHILE &CurrAddr<=&ScriptEnd
(
  &ByteVal=Data.Byte(ezaxi:&CurrAddr)

  IF &MatchState==0
  (
    IF &ByteVal==0x67  ; 'g'
      &MatchState=1
  )
  ELSE IF &MatchState==1
  (
    IF &ByteVal==0x6C  ; 'l'
      &MatchState=2
    ELSE
      &MatchState=0
  )
  ELSE IF &MatchState==2
  (
    IF &ByteVal==0x6F  ; 'o'
      &MatchState=3
    ELSE
      &MatchState=0
  )
  ELSE IF &MatchState==3
  (
    IF &ByteVal==0x62  ; 'b'
      &MatchState=4
    ELSE
      &MatchState=0
  )
  ELSE IF &MatchState==4
  (
    IF &ByteVal==0x61  ; 'a'
      &MatchState=5
    ELSE
      &MatchState=0
  )
  ELSE IF &MatchState==5
  (
    IF &ByteVal==0x6C  ; 'l'
      &MatchState=6
    ELSE
      &MatchState=0
  )
  ELSE IF &MatchState==6
  (
    IF &ByteVal==0x20  ; ' '
      &MatchState=7
    ELSE
      &MatchState=0
  )
  ELSE IF &MatchState==7
  (
    IF &ByteVal==0x26  ; '&'
    (
      &MatchState=8
      &NameStart=&CurrAddr+1
    )
    ELSE
      &MatchState=0
  )
  ELSE IF &MatchState==8
  (
    ; Reading Name. Terminate on space (0x20), CR (0x0D), LF (0x0A)
    IF (&ByteVal==0x20)||(&ByteVal==0x0D)||(&ByteVal==0x0A)
    (
      &NameLen=&CurrAddr-&NameStart

      ; Extract name string from DDR using Data.STRingN (safe length)
      &PkgName=Data.STRingN(A:&NameStart, &NameLen)

      ; Check suffixes
      IF (STR.SCAN("&PkgName", "Obj", 0)==-1)&&(STR.SCAN("&PkgName", "RelPath", 0)==-1)
      (
         WRITE #2 "GLOBAL &" "&PkgName"
         WRITE #2 "&" "&PkgName" "=""&WorkspaceRoot"""

         ; Add the board package source directory as a targeted fallback.
         ; y.spath.translate in the extracted script handles exact path
         ; mapping for all other packages (edk2/, edk2-qualcomm/, etc.)
         ; without requiring a slow recursive directory scan.
         WRITE #2 "y.spath.SetRecurseDIR ""&WorkspaceRoot/&PkgName"""

         PRINT "Found Package: &PkgName"
      )

      &MatchState=0
    )
  )

  &CurrAddr=&CurrAddr+1
)

;----------------------------------------------------------------------------
; 4. Save Extracted Script
;----------------------------------------------------------------------------
; Save binary blob to file
Data.SAVE.Binary "&TempFile" ezaxi:&ScriptStart--&ScriptEnd

PRINT "Extracted &ScriptLen bytes to &TempFile"

; Append the extracted script execution to wrapper
WRITE #2 "do ""&TempFile"""
CLOSE #2

;----------------------------------------------------------------------------
; 5. Execute
;----------------------------------------------------------------------------
PRINT "Loading symbols..."
DO "&WrapperFile"

; Restore UI components if available
IF OS.FILE("&CwDir/T32UefiMenu.cmm")
(
  DO "&CwDir/T32UefiMenu.cmm" "&CwDir"
)

IF OS.FILE("&CwDir/win.cmm")
(
  DO "&CwDir/win.cmm"
)

PRINT "Done. Symbols loaded."
ENDDO
