;;@file
;;  Iq10Evk target-specific wrapper for the generic Qualcomm Trace32 UEFI symbol loading flow.
;;
;;  Copyright (c) Qualcomm Technologies, Inc. and/or its subsidiaries.
;;  SPDX-License-Identifier: BSD-2-Clause-Patent
;;

;============================================================================
;  FUNCTION:  main
;
;  Example:
;    do NordMinPlatformSymbolLoad.cmm
;============================================================================
LOCAL &CwDir
LOCAL &WorkspaceRoot
LOCAL &DebugScriptMetaDataBufferAddress
LOCAL &DebugScriptMetaDataBufferSize

&CwDir=os.ppd()
&WorkspaceRoot="&CwDir/../../../../.."

&DebugScriptMetaDataBufferAddress=0x9FFFB000
&DebugScriptMetaDataBufferSize=0x5000

DO "&WorkspaceRoot/edk2-qualcomm/Platform/Qualcomm/QualcommMinplatformPkg/Tools/Trace32/SymbolLoad.cmm" &DebugScriptMetaDataBufferAddress &DebugScriptMetaDataBufferSize

ENDDO