/** @file
  Device tree defination all JH7110 display audio for StarFive VisionFive 2 platform

  Copyright (c) 2023, StarFive Technology Co., Ltd. All rights reserved.<BR>

  SPDX-License-Identifier: BSD-2-Clause-Patent

**/

&sound1 {
    /* i2s + hdmi */
    simple-audio-card,dai-link@0 {
        reg = <0>;
        format = "i2s";
        bitclock-master = <&sndi2s0>;
        frame-master = <&sndi2s0>;
        mclk-fs = <256>;
        status = "okay";

        sndi2s0: cpu {
            sound-dai = <&i2stx_4ch0>;
        };

        sndhdmi0: codec {
            sound-dai = <&hdmi>;
        };
    };
};
